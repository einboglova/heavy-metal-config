## boards/shields/helix/Kconfig.shield
```kconfig
# No whitespace after the comma or in the keyboard name!
config HELIX_DONGLE
    def_bool $(shields_list_contains,helix_dongle)
```

## boards/shields/helix/kconfig.shield
```kconfig
# No whitespace after the comma or in the keyboard name!
config SHIELD_HELIX_LEFT_DONGLE
    def_bool $(shields_list_contains,helix_left_dongle)
```

## config/west.yml
```yaml
manifest:
  remotes:
    - name: zmkfirmware
      url-base: https://github.com/zmkfirmware
    # support nice_oled and nice_epaper
    - name: mctechnology17
      url-base: https://github.com/mctechnology17
    - name: einboglova
      url-base: https://github.com/einboglova
  projects:
    - name: zmk
      remote: zmkfirmware
      revision: v0.3.0
      import: app/west.yml
    # support nice_oled and nice_epaper
    - name: zmk-nice-oled
      remote: mctechnology17
      revision: main
    - name: stainless-dongle
      remote: einboglova
      revision: main
  self:
    path: config
```

## shields/helix/kconfig.shield
```kconfig
# No whitespace after the comma or in the keyboard name!
config helix
    def_bool $(shields_list_contains,helix)
```
